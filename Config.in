## Config.in
```kconfig
source "$BR2_EXTERNAL_KIVYCFG_PATH/package/python-kivy/Config.in"
source "$BR2_EXTERNAL_KIVYCFG_PATH/package/python-cython-v02926/Config.in.host"
source "$BR2_EXTERNAL_KIVYCFG_PATH/package/python-evdev/Config.in"
source "$BR2_EXTERNAL_KIVYCFG_PATH/package/python-adcdacpi/Config.in"
source "$BR2_EXTERNAL_KIVYCFG_PATH/package/python-pwm/Config.in"
```

## configs/intelstick_defconfig
```kconfig
# ##############################################################################
# From Buildroot's original pc_x86_64_efi_defconfig
# ##############################################################################

BR2_x86_64=y
BR2_PACKAGE_HOST_LINUX_HEADERS_CUSTOM_4_19=y
BR2_TOOLCHAIN_BUILDROOT_WCHAR=y
BR2_ROOTFS_DEVICE_CREATION_DYNAMIC_EUDEV=y
BR2_TARGET_GENERIC_GETTY_PORT="tty1"
BR2_ROOTFS_POST_BUILD_SCRIPT="board/pc/post-build.sh"
BR2_ROOTFS_POST_IMAGE_SCRIPT="board/pc/post-image-efi.sh"
BR2_LINUX_KERNEL=y
BR2_LINUX_KERNEL_CUSTOM_VERSION=y
BR2_LINUX_KERNEL_CUSTOM_VERSION_VALUE="4.19.234"
BR2_LINUX_KERNEL_USE_CUSTOM_CONFIG=y
BR2_LINUX_KERNEL_CUSTOM_CONFIG_FILE="board/pc/linux.config"
BR2_LINUX_KERNEL_INSTALL_TARGET=y
BR2_LINUX_KERNEL_NEEDS_HOST_OPENSSL=y
BR2_PACKAGE_LINUX_FIRMWARE=y
BR2_PACKAGE_LINUX_FIRMWARE_ATHEROS_9170=y
BR2_PACKAGE_LINUX_FIRMWARE_ATHEROS_9271=y
BR2_PACKAGE_LINUX_FIRMWARE_IWLWIFI_3160=y
BR2_PACKAGE_LINUX_FIRMWARE_IWLWIFI_3168=y
BR2_PACKAGE_LINUX_FIRMWARE_IWLWIFI_5000=y
BR2_PACKAGE_LINUX_FIRMWARE_IWLWIFI_6000G2A=y
BR2_PACKAGE_LINUX_FIRMWARE_IWLWIFI_6000G2B=y
BR2_PACKAGE_LINUX_FIRMWARE_IWLWIFI_7260=y
BR2_PACKAGE_LINUX_FIRMWARE_IWLWIFI_7265D=y
BR2_PACKAGE_LINUX_FIRMWARE_IWLWIFI_8000C=y
BR2_PACKAGE_LINUX_FIRMWARE_IWLWIFI_8265=y
BR2_PACKAGE_LINUX_FIRMWARE_RALINK_RT73=y
BR2_PACKAGE_LINUX_FIRMWARE_RALINK_RT2XX=y
BR2_PACKAGE_LINUX_FIRMWARE_RTL_81XX=y
BR2_PACKAGE_LINUX_FIRMWARE_RTL_87XX=y
BR2_PACKAGE_LINUX_FIRMWARE_RTL_88XX=y
BR2_PACKAGE_LINUX_FIRMWARE_RTL_8169=y
BR2_PACKAGE_ACPID=y
### Removed: BR2_PACKAGE_CONNMAN=y
### Removed: BR2_PACKAGE_CONNMAN_WIFI=y
### Removed: BR2_PACKAGE_CONNMAN_CLIENT=y
BR2_TARGET_ROOTFS_EXT2=y
BR2_TARGET_ROOTFS_EXT2_4=y
### Replaced: BR2_TARGET_ROOTFS_EXT2_SIZE="120M"
# BR2_TARGET_ROOTFS_TAR is not set
BR2_TARGET_GRUB2=y
BR2_TARGET_GRUB2_X86_64_EFI=y
BR2_PACKAGE_HOST_DOSFSTOOLS=y
BR2_PACKAGE_HOST_GENIMAGE=y
BR2_PACKAGE_HOST_MTOOLS=y


# ##############################################################################
# Customization
# ##############################################################################

BR2_CCACHE=y
BR2_TOOLCHAIN_BUILDROOT_GLIBC=y
BR2_TOOLCHAIN_BUILDROOT_CXX=y

# Without this the device will complain at boot: failed to load regulatory.db
BR2_PACKAGE_WIRELESS_REGDB=y

# Processor
BR2_x86_atom=y

# Kernel additional configuration
BR2_LINUX_KERNEL_CONFIG_FRAGMENT_FILES="$(BR2_EXTERNAL_KIVYCFG_PATH)/board/pc/STK1AW32SC/kernel/linux.fragment"

# Nano editor
BR2_PACKAGE_NANO=y
BR2_TARGET_GENERIC_ROOT_PASSWD="1"
BR2_PACKAGE_DROPBEAR=y	# SSH
BR2_PACKAGE_DHCPCD=y

# Overlay
BR2_ROOTFS_OVERLAY="$(BR2_EXTERNAL_KIVYCFG_PATH)/rootfs_overlay"

# Exact size
BR2_TARGET_ROOTFS_EXT2_SIZE="256M"


# ##############################################################################
# Kivy graphics support (Uses Open GL)
# Intel Stick STK1AW32SC
# ##############################################################################

BR2_PACKAGE_PYTHON_KIVY=y
BR2_PACKAGE_PYTHON_KIVY_GLES_MESA_X11=y  # GLES, Mesa and X11 Embedded
# BR2_PACKAGE_PYTHON_KIVY_GSTREAMER=y

# Hardware specific in the case of the Intel Stick STK1AW32SC
# BR2_PACKAGE_MESA3D_GALLIUM_DRIVER_I915=y

# X11 related
BR2_PACKAGE_XSERVER_XORG_SERVER_KDRIVE=y  # Use KDrive instead of the Modular
# BR2_PACKAGE_X11VNC=y  # Optional, to provide a VNC service
```

## configs/rpi2_defconfig
```kconfig
# ##############################################################################
# From Buildroot's original rpi2_defconfig
# ##############################################################################

BR2_arm=y
BR2_cortex_a7=y
BR2_ARM_FPU_NEON_VFPV4=y
BR2_PACKAGE_HOST_LINUX_HEADERS_CUSTOM_5_10=y
BR2_TOOLCHAIN_BUILDROOT_CXX=y
BR2_SYSTEM_DHCP="eth0"
BR2_ROOTFS_POST_BUILD_SCRIPT="board/raspberrypi2/post-build.sh"
BR2_ROOTFS_POST_IMAGE_SCRIPT="board/raspberrypi2/post-image.sh"
BR2_LINUX_KERNEL=y
BR2_LINUX_KERNEL_CUSTOM_TARBALL=y
BR2_LINUX_KERNEL_CUSTOM_TARBALL_LOCATION="$(call github,raspberrypi,linux,581049d718caf95f5feb00607ac748d5841cf27c)/linux-581049d718caf95f5feb00607ac748d5841cf27c.tar.gz"
BR2_LINUX_KERNEL_DEFCONFIG="bcm2709"
BR2_LINUX_KERNEL_DTS_SUPPORT=y
BR2_LINUX_KERNEL_INTREE_DTS_NAME="bcm2709-rpi-2-b"
BR2_LINUX_KERNEL_NEEDS_HOST_OPENSSL=y
BR2_PACKAGE_RPI_FIRMWARE=y
BR2_PACKAGE_RPI_FIRMWARE_BOOTCODE_BIN=y
BR2_PACKAGE_RPI_FIRMWARE_VARIANT_PI=y
### Replaced: BR2_PACKAGE_RPI_FIRMWARE_CONFIG_FILE="board/raspberrypi/config_default.txt"
# BR2_PACKAGE_RPI_FIRMWARE_INSTALL_DTB_OVERLAYS is not set
BR2_TARGET_ROOTFS_EXT2=y
BR2_TARGET_ROOTFS_EXT2_4=y
### Replaced: BR2_TARGET_ROOTFS_EXT2_SIZE="120M"
# BR2_TARGET_ROOTFS_TAR is not set
BR2_PACKAGE_HOST_DOSFSTOOLS=y
BR2_PACKAGE_HOST_GENIMAGE=y
BR2_PACKAGE_HOST_MTOOLS=y


# ##############################################################################
# Customization
# ##############################################################################

BR2_CCACHE=y
BR2_TOOLCHAIN_BUILDROOT_GLIBC=y
BR2_TOOLCHAIN_BUILDROOT_CXX=y

# Without this the device will complain at boot: failed to load regulatory.db
BR2_PACKAGE_WIRELESS_REGDB=y

# Custom config
BR2_PACKAGE_RPI_FIRMWARE_CONFIG_FILE="$(BR2_EXTERNAL_KIVYCFG_PATH)/board/raspberry/pi2/singleboot/config.txt"

# Overlay
BR2_ROOTFS_OVERLAY="$(BR2_EXTERNAL_KIVYCFG_PATH)/rootfs_overlay"

# Exact size
BR2_TARGET_ROOTFS_EXT2_SIZE="256M"


# ##############################################################################
# Kivy graphics support
# RPi2 uses Open GL ES. Then, inspecting BR2_PACKAGE_HAS_LIBGLES on menuconfig
# it should be true.
# ##############################################################################

BR2_PACKAGE_PYTHON_KIVY=y

BR2_PACKAGE_RPI_USERLAND=y  # Provides graphics hardware
BR2_PACKAGE_SDL=y  # To determine
BR2_PACKAGE_SDL2_OPENGLES=y  # OpenGLES support (Like Raspberry Pi2)
```

## package/python-adcdacpi/Config.in
```kconfig
config BR2_PACKAGE_PYTHON_ADCDACPI
    bool "python-adcdacpi"
    help
        Python Library to use with ADCDAC Pi Raspberry Pi expansion board.
        
        https://www.abelectronics.co.uk
```

## package/python-cython-v0282/Config.in.host
```kconfig
config BR2_PACKAGE_HOST_PYTHON_CYTHON_V0282
    bool "host python-cython-v0282"
    help
      The Cython compiler for writing C extensions for the Python
      language.

      http://cython.org/
```

## package/python-cython-v02926/Config.in.host
```kconfig
config BR2_PACKAGE_HOST_PYTHON_CYTHON_V02926
    bool "host python-cython-v02926"
    help
      The Cython compiler for writing C extensions for the Python
      language.

      http://cython.org/
```

## package/python-evdev/Config.in
```kconfig
config BR2_PACKAGE_PYTHON_EVDEV
    bool "python-evdev"
    help
        Provides bindings to the generic input event
        interface in Linux by passing events generated
        in the kernel directly to userspace through
        character devices e.g. in /dev/input/.
        
        http://python-evdev.rtfd.org/
```

## package/python-kivy/Config.in
```kconfig
config BR2_PACKAGE_PYTHON_KIVY
    bool "python-kivy"
    default n

    # According to official Kivy 2.1 documentation and from inspecting different
    # build results the next are required:
    select BR2_PACKAGE_HOST_PYTHON_CYTHON
    select BR2_PACKAGE_PYTHON3
    select BR2_PACKAGE_SDL2  # libsdl2-dev
    select BR2_PACKAGE_SDL2_IMAGE  # libsdl2-image-dev
    select BR2_PACKAGE_SDL2_MIXER  # libsdl2-mixer-dev
    select BR2_PACKAGE_SDL2_TTF  # libsdl2-ttf-dev
    select BR2_PACKAGE_ZLIB  # zlib1g-dev
    select BR2_PACKAGE_MTDEV  # Multi-touch devices to use for input
    select BR2_PACKAGE_LIBPNG
    select BR2_PACKAGE_PYTHON_DOCUTILS
    select BR2_PACKAGE_PYTHON_PYGMENTS

    # The next requirements according to the Kivy 2.1 documentation, have not
    # been identified, but seem to be included somehow:
    # libportmidi-dev
    # libswscale-dev
    # libavformat-dev
    # libavcodec-dev

    # TODO: Determine why are the next packages required in some cases
    select BR2_PACKAGE_UTIL_LINUX  # Required by LIBUUID
    select BR2_PACKAGE_UTIL_LINUX_LIBUUID  # Required by PANGO dependency on fontconfig-2.13.1
    select BR2_PACKAGE_PANGO  # Some Kivy builds report missing this. Pango is a library for laying out and rendering of text, with an emphasis on internationalization

    help
        A software library for rapid development of
        hardware-accelerated multitouch applications.

        http://kivy.org

        CGL: standard C interface for OpenGL
        https://kivy.org/doc/stable/api-kivy.graphics.cgl.html


        Notice:
        This is a work in progress. Any help is greatly appreciated.
        https://github.com/MrMauro/buildroot_external_kivy/tree/main/package/python-kivy
      
        Those references are among the sources used to build this:
        https://github.com/foozmeat/hotline/tree/master/buildroot/hotline-external/package/python-kivy
        http://lists.busybox.net/pipermail/buildroot/2019-June/253526.html
        https://forums.raspberrypi.com/viewtopic.php?t=307052
        https://forums.raspberrypi.com/viewtopic.php?t=242588


if BR2_PACKAGE_PYTHON_KIVY

config BR2_PACKAGE_PYTHON_KIVY_GSTREAMER
    bool "GStreamer"
    default n

    select BR2_PACKAGE_GSTREAMER1  # libgstreamer1.0 gstreamer Optional by Kivy 2.1 for audio, video
    select BR2_PACKAGE_GST1_PLUGINS_BASE  # gstreamer1.0-plugins-base Optional by Kivy 2.1 for audio, video
    select BR2_PACKAGE_GST1_PLUGINS_BASE_INSTALL_TOOLS  # Install the gst-discoverer, gst-device-monitor and gst-play tools.    
    select BR2_PACKAGE_GST1_PLUGINS_BASE_PLUGIN_ALSA   # ALSA plugin library, mandatory for audio playback
    select BR2_PACKAGE_GST1_PLUGINS_GOOD  # gstreamer1.0-plugins-good Optional by Kivy 2.1 for audio, video
    select BR2_PACKAGE_GST1_PLUGINS_GOOD_PLUGIN_AUTODETECT  # Plugin contains auto-detection plugins for video/audio in and outputs 

    help
        Audio and video support.

config BR2_PACKAGE_PYTHON_KIVY_RPI
    bool "Raspberry Pi"
    default n

    select BR2_PACKAGE_RPI_USERLAND  # Provides graphics hardware
    select BR2_PACKAGE_SDL2_OPENGLES  # OpenGLES support

    help
        Select this for Raspberry Pi targets (Tested for Pi2).

        Window provider will be sdl2
        GL backend will be sdl2/gl

        The RPI_USERLAND package will be selected.

        TODO: 
        Provide a way to select window provider and GL backend according to: 
        https://kivy.org/doc/stable/installation/installation-rpi.html

config BR2_PACKAGE_PYTHON_KIVY_GLES_MESA_X11
    bool "OpenGLES, Mesa, X11"
    default n

    select BR2_PACKAGE_SDL2_OPENGL  # Option?
    select BR2_PACKAGE_SDL2_OPENGLES  # OpenGLES support

    select BR2_PACKAGE_MESA3D
    select BR2_PACKAGE_MESA3D_OPENGL_ES
    select BR2_PACKAGE_MESA3D_OPENGL_EGL
    select BR2_PACKAGE_MESA3D_GALLIUM_DRIVER_SWRAST  # Required, otherwise Kivy at runtime reports: libGL error: MESA-LOADER: failed to open swrast

    select BR2_PACKAGE_SDL2_X11  # Required, otherwise Kivy won't compile reporting error: ...has no member named ‘x11’
    select BR2_PACKAGE_MESA3D_OPENGL_GLX
    select BR2_PACKAGE_XORG7
    select BR2_PACKAGE_XLIB_LIBXRENDER
    select BR2_PACKAGE_XSERVER_XORG_SERVER

    select BR2_PACKAGE_XAPP_XINIT
    select BR2_PACKAGE_XAPP_TWM
    select BR2_PACKAGE_XDRIVER_XF86_INPUT_KEYBOARD if !BR2_PACKAGE_XSERVER_XORG_SERVER_KDRIVE
    select BR2_PACKAGE_XDRIVER_XF86_INPUT_MOUSE if !BR2_PACKAGE_XSERVER_XORG_SERVER_KDRIVE
    select BR2_PACKAGE_XDRIVER_XF86_VIDEO_INTEL if !BR2_PACKAGE_XSERVER_XORG_SERVER_KDRIVE
    select BR2_PACKAGE_XDRIVER_XF86_VIDEO_VESA if !BR2_PACKAGE_XSERVER_XORG_SERVER_KDRIVE
    select BR2_PACKAGE_XTERM

    help
        Additional Mesa and X11 drivers are not installed.

        To enable X11 KDrive (instead of the default Modular), select
        manually BR2_PACKAGE_XSERVER_XORG_SERVER_KDRIVE=y

        Window provider for Kivy will be X11.
        GL backend for Kivy will be sdl2.

config BR2_PACKAGE_PYTHON_KIVY_EXAMPLES
    bool "Kivy examples"
    default n

    help
        Enable this to keep Kivy examples.
        If selected those wil be located at /usr/share/kivy-examples on the
        target.

endif
```

## package/python-pwm/Config.in
```kconfig
config BR2_PACKAGE_PYTHON_PWM
    bool "python-pwm"
    help
        Python class to work with the Linux PWM kernel driver.
```
